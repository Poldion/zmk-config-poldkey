## boards/shields/PoldKey/Kconfig.defconfig
```kconfig
if SHIELD_POLDKEY

config ZMK_KEYBOARD_NAME
    default "PoldKey"

config BT_CENTRAL
    default n

config BT_PERIPHERAL
    default y

endif
```

## boards/shields/PoldKey/Kconfig.shield
```kconfig
config SHIELD_POLDKEY
    def_bool $(shields_list_contains,PoldKey)

config POLDKEY_DONGLE
    def_bool $(shields_list_contains,PoldKey_dongle)
```

## boards/shields/PoldKey_dongle/Kconfig.defconfig
```kconfig
if POLDKEY_DONGLE

# Max 16 characters in keyboard name
config ZMK_KEYBOARD_NAME
    default "PoldKey Dongle"

config ZMK_SPLIT_ROLE_CENTRAL
    default y

config ZMK_SPLIT
    default y

# Limit BLE host connections and pairing slots
config ZMK_SPLIT_BLE_CENTRAL_PERIPHERALS
    default 1

config BT_MAX_CONN
    default 6

config BT_MAX_PAIRED
    default 6

# Force roles: central on, peripheral off
config BT_CENTRAL
    default y

config BT_PERIPHERAL
    default n

endif
```
